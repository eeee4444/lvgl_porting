## main/Kconfig.projbuild
```kconfig
menu "示例配置"

    menu "显示"
        config EXAMPLE_LCD_RGB_BOUNCE_BUFFER_HEIGHT
            int "RGB 弹跳缓冲高度"
            default 10
            help
                弹跳缓冲的高度。缓冲区的宽度与 LCD 的宽度相同。

        config EXAMPLE_LVGL_PORT_TASK_MAX_DELAY_MS
            int "LVGL 定时器任务最大延时 (ms)"
            default 500
            range 2 2000  # 示例范围，可按需调整
            help
            LVGL 定时器任务的最大延时，单位为毫秒。

        config EXAMPLE_LVGL_PORT_TASK_MIN_DELAY_MS
            int "LVGL 定时器任务最小延时 (ms)"
            default 10
            range 1 100  # 示例范围，可按需调整
            help
            LVGL 定时器任务的最小延时，单位为毫秒。

        config EXAMPLE_LVGL_PORT_TASK_PRIORITY
            int "LVGL 任务优先级"
            default 2
            help
                板级支持包会创建一个任务，在 lv_timer_handler() 中周期性地处理 LVGL 操作。

        config EXAMPLE_LVGL_PORT_TASK_STACK_SIZE_KB
            int "LVGL 任务栈大小 (KB)"
            default 6
            help
                LVGL 任务栈的大小（KB）。

        config EXAMPLE_LVGL_PORT_TASK_CORE
            int "LVGL 定时器任务所在核心"
            default -1
            range -1 1
            help
            LVGL 定时器任务所使用的核心。
            设为 -1 表示不指定核心。
            仅当 SoC 支持双核时才设为 1，否则请设为 -1 或 0。

        config EXAMPLE_LVGL_PORT_TICK
            int "LVGL 时钟节拍周期"
            default 2
            range 1 100
            help
                LVGL 时钟节拍定时器的周期。

        config EXAMPLE_LVGL_PORT_AVOID_TEAR_ENABLE
            bool "启用防撕裂"
            default "n"
            help
                通过 LVGL 缓冲模式与 RGB LCD 的双帧缓冲来实现防撕裂。该功能仅适用于 RGB LCD。

        choice
            depends on EXAMPLE_LVGL_PORT_AVOID_TEAR_ENABLE
            prompt "选择防撕裂模式"
            default EXAMPLE_LVGL_PORT_AVOID_TEAR_MODE_3
            config EXAMPLE_LVGL_PORT_AVOID_TEAR_MODE_1
                bool "Mode1：LCD 双缓冲 & LVGL 全屏刷新"
            config EXAMPLE_LVGL_PORT_AVOID_TEAR_MODE_2
                bool "Mode2：LCD 三缓冲 & LVGL 全屏刷新"
            config EXAMPLE_LVGL_PORT_AVOID_TEAR_MODE_3
                bool "Mode3：LCD 双缓冲 & LVGL 直接模式"
            help
                当前的防撕裂模式同时支持全屏刷新模式与直接模式。防撕裂模式可能会占用更多 PSRAM 空间
        endchoice

        config EXAMPLE_LVGL_PORT_AVOID_TEAR_MODE
            depends on EXAMPLE_LVGL_PORT_AVOID_TEAR_ENABLE
            int
            default 1 if EXAMPLE_LVGL_PORT_AVOID_TEAR_MODE_1
            default 2 if EXAMPLE_LVGL_PORT_AVOID_TEAR_MODE_2
            default 3 if EXAMPLE_LVGL_PORT_AVOID_TEAR_MODE_3

        choice
            depends on EXAMPLE_LVGL_PORT_AVOID_TEAR_ENABLE
            prompt "选择旋转角度"
            default EXAMPLE_LVGL_PORT_ROTATION_0
            config EXAMPLE_LVGL_PORT_ROTATION_0
                bool "旋转 0°"
            config EXAMPLE_LVGL_PORT_ROTATION_90
                bool "旋转 90°"
            config EXAMPLE_LVGL_PORT_ROTATION_180
                bool "旋转 180°"
            config EXAMPLE_LVGL_PORT_ROTATION_270
                bool "旋转 270°"
        endchoice

        config EXAMPLE_LVGL_PORT_ROTATION_DEGREE
            int
            default 0 if EXAMPLE_LVGL_PORT_ROTATION_0
            default 90 if EXAMPLE_LVGL_PORT_ROTATION_90
            default 180 if EXAMPLE_LVGL_PORT_ROTATION_180
            default 270 if EXAMPLE_LVGL_PORT_ROTATION_270

        choice
            depends on !EXAMPLE_LVGL_PORT_AVOID_TEAR_ENABLE
            prompt "选择 LVGL 缓冲区的内存类型"
            default EXAMPLE_LVGL_PORT_BUF_INTERNAL
            config EXAMPLE_LVGL_PORT_BUF_PSRAM
                bool "PSRAM 内存"
            config EXAMPLE_LVGL_PORT_BUF_INTERNAL
                bool "内部内存"
        endchoice

        config EXAMPLE_LVGL_PORT_BUF_HEIGHT
            depends on !EXAMPLE_LVGL_PORT_AVOID_TEAR_ENABLE
            int "LVGL 缓冲高度"
            default 100
            help
                LVGL 缓冲的高度。缓冲区的宽度与 LCD 的宽度相同。
    endmenu
endmenu
```
